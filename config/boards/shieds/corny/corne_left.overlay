/ {
    zephyr,keyboard-matrix {
        label = "Corne42";

        // Define the matrix size (4 rows x 6 columns)
        rows = <4>;
        columns = <6>;

        // Pin connections for rows (High-Frequency Pins)
        row-gpios = <&gpio0 17 0>,  // Row 1 -> P0.17 (D2)
                    <&gpio0 20 0>,  // Row 2 -> P0.20 (D3)
                    <&gpio0 22 0>,  // Row 3 -> P0.22 (D4)
                    <&gpio0 24 0>;  // Row 4 -> P0.24 (D5)

        // Pin connections for columns (Simplified Layout)
        col-gpios = <&gpio0 31 0>,  // Column 1 -> P0.31
                    <&gpio0 29 0>,  // Column 2 -> P0.29
                    <&gpio0 2 0>,   // Column 3 -> P0.02
                    <&gpio1 15 0>,  // Column 4 -> P1.15
                    <&gpio1 13 0>,  // Column 5 -> P1.13
                    <&gpio1 11 0>;  // Column 6 -> P1.11
    };
};
